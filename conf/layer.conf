## conf/layer.conf
```bitbake
# We have a conf and classes directory, add to BBPATH
BBPATH .= ":${LAYERDIR}"
# We have a packages directory, add to BBFILES
BBFILES += "${LAYERDIR}/recipes-*/*/*.bb ${LAYERDIR}/recipes*/*/*.bbappend"

BBFILE_COLLECTIONS += "trik"
BBFILE_PATTERN_trik := "^${LAYERDIR}/"
BBFILE_PRIORITY_trik = "100"

# This should only be incremented on significant changes that will
# cause compatibility issues with other layers
LAYERVERSION_trik = "1"

LAYERSERIES_COMPAT_trik = "morty poky rocko sumo thud warrior zeus"
```

## wic/sdimage-2part.wks
```
# short-description: Create SD card image with 2 partitions
# long-description: Creates a partitioned SD card image for TI platforms.
# Boot files are located in the first vfat partition with extra reserved space.

part /boot --source bootimg-partition --ondisk mmc0 --fstype=ext4 --label boot --active --align 1024 --fixed-size 128 --use-uuid
part / --source rootfs --ondisk mmc0 --fstype=ext4 --label root --align 1024 --use-uuid --exclude-path=boot/
```

## wic/sdimage.wks
```
# short-description: Create SD card image with 2 partitions
# long-description: Creates a partitioned SD card image for TI platforms.
# Boot files are located in the first vfat partition with extra reserved space.

part /boot --source bootimg-partition --fstype=vfat --label boot --active --align 1024 --fixed-size 128 --use-uuid
part / --source rootfs --fstype=ext4 --label root --align 4096 --use-uuid
```
